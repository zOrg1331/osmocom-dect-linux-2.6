## drivers/dect/Kconfig
```kconfig
menuconfig DECTDEVICES
	bool "DECT device support"
	help
	  Say Y here to show DECT device driver options.

if DECTDEVICES

source "drivers/dect/vtrx/Kconfig"
source "drivers/dect/coa/Kconfig"

endif
```

## drivers/dect/coa/Kconfig
```kconfig
config DECT_COA_CS
	tristate "Com-on-Air PCMCIA DECT support"
	depends on DECT
	depends on PCMCIA
	select DECT_COA
	select DECT_COA_U2785
	select DECT_COA_LMX3161
	select CRC32
	help
	  This option enables support for the Com-on-Air DECT PCMCIA devices.

config DECT_COA
	tristate

config DECT_COA_U2785
	bool

config DECT_COA_LMX3161
	bool

config DECT_COA_FIRMWARE
	bool "Build Com-on-Air firmware (requires ASL macro assembler)"
	depends on DECT_COA
	help
	  This option enables rebuild of the firmware for the Com-on-Air
	  devices during the kernel build process. The ASL macro compiler
	  is required for this.

	  If unsure, say N.
```

## drivers/dect/vtrx/Kconfig
```kconfig
config DECT_VTRX
	tristate "DECT virtual transceiver support"
	depends on DECT
	help
	  This option enables support for the virtual DECT transceiver.
```

## net/dect/Kconfig
```kconfig
menuconfig DECT
	tristate "DECT protocol support"
	help
	  This option enables support for the DECT protocol.

	  If unsure, say N.

if DECT

config DECT_DEBUG
	bool "DECT debugging"
	help
	  This option enables support for debugging in the DECT modules.

	  If unsure, say N.

config DECT_CSF
	tristate "DECT Cell Site Functions (CSF) support"
	help
	  This option enables support for DECT Cell Site Functions. A DECT
	  cell is a radio endpoint containing one or more transceivers.

	  If unsure, say N.

config DECT_RAW
	tristate "DECT raw sockets"
	depends on DECT_CSF
	help
	  This option enables support for PF_DECT raw sockets. DECT raw
	  sockets are used to receive raw frames from DECT devices.

	  If unsure, say N.

config DECT_CCF
	tristate "DECT Cluster Control Functions (CCF) support"
	help
	  This option enables support for the DECT Cluster Control Functions.

	  A DECT cluster is a Portable radio Termination (PT), containing a
	  single cell, or a Fixed radio Termination (FT), containing up to
	  8 cells.

	  If unsure, say N.

config DECT_LU1_SAP
	tristate "DECT DLC LU1 SAP sockets"
	select DECT_CCF
	help
	  This option enables support for PF_DECT DLC LU1 SAP sockets. DECT
	  DLC LU1 SAP sockets are used for the TRUP (TRansparent UnProtected)
	  service, most commonly used for audio.

	  If unsure, say N.

config DECT_CCP
	tristate "DECT Cell Control Protocol support"
	depends on DECT_CSF || DECT_CCF
	select TIPC
	help
	  This option enables support for the DECT Cell Control Protocol.
	  This can be used to remotely control one or multiple DECT cells
	  by the DECT cluster control functions.

	  If unsure, say N.

endif
```
